## sources/meta-aurora/conf/layer.conf
```bitbake
# We have a conf and classes directory, add to BBPATH
BBPATH .= ":${LAYERDIR}"

# We have recipes-* directories, add to BBFILES
BBFILES += "${LAYERDIR}/recipes-*/*/*.bb \
            ${LAYERDIR}/recipes-*/*/*.bbappend"

BBFILE_COLLECTIONS += "meta-aurora"
BBFILE_PATTERN_meta-aurora = "^${LAYERDIR}/"
BBFILE_PRIORITY_meta-aurora = "25"

LAYERDEPENDS_meta-aurora = "core"
LAYERSERIES_COMPAT_meta-aurora = "hardknott"
#PREFERRED_VERSION_gtk+3 = "3.0"
SECURITY_STRINGFORMAT = ""
```
